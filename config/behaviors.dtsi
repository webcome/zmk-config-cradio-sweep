/ {
    behaviors {
        sticky_comma: sticky_comma {
            compatible = "zmk,behavior-sticky-key";
            label = "Sticky COMMA";
            #binding-cells = <1>;
            release-after-ms = <500>;
        };
    };
};